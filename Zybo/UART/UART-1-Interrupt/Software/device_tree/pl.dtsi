/*
 * CAUTION: This file is automatically generated by Xilinx.
 * Version: XSCT 2019.2
 * Today is: Wed Jun 24 18:08:58 2020
 */


/ {
	amba_pl: amba_pl {
		#address-cells = <1>;
		#size-cells = <1>;
		compatible = "simple-bus";
		ranges ;
		myUart_one_interrupt_0: myUart_one_interrupt@43c00000 {
			/* This is a place holder node for a custom IP, user may need to update the entries */
			clock-names = "s00_axi_aclk";
			clocks = <&clkc 15>;
			/*compatible = "xlnx,myUart-one-interrupt-1.0";*/
			compatible = "generic-uio";
			interrupt-controller;
			interrupt-names = "interrupt";
			interrupt-parent = <&intc>;
			interrupts = <0 29 4>;
			reg = <0x43c00000 0x10000>;
			xlnx,s00-axi-addr-width = <0x4>;
			xlnx,s00-axi-data-width = <0x20>;
		};
		myUart_one_interrupt_1: myUart_one_interrupt@43c10000 {
			/* This is a place holder node for a custom IP, user may need to update the entries */
			clock-names = "s00_axi_aclk";
			clocks = <&clkc 15>;
			/*compatible = "xlnx,myUart-one-interrupt-1.0";*/
			compatible = "generic-uio";
			interrupt-controller;
			interrupt-names = "interrupt";
			interrupt-parent = <&intc>;
			interrupts = <0 30 4>;
			reg = <0x43c10000 0x10000>;
			xlnx,s00-axi-addr-width = <0x4>;
			xlnx,s00-axi-data-width = <0x20>;
		};
	};
};
